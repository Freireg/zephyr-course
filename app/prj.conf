## prj.conf
```kconfig
CONFIG_LOG=y
CONFIG_LOG_MODE_IMMEDIATE=y
CONFIG_CPP=y
CONFIG_TASK_WDT=y
```

## boards/qemu_cortex_m3.conf
```kconfig
# The board defaults to 100 ticks/s, too coarse for the 4 ms burst spacing
CONFIG_SYS_CLOCK_TICKS_PER_SEC=1000
```

## src/main.c
```c
#include <zephyr/kernel.h>
#include <stdio.h>
#include <string.h>
#include "credentials.h"
#include "parser.h"

#define PARSER_STACK_SIZE 2048

K_THREAD_STACK_DEFINE(parser_stack, PARSER_STACK_SIZE);
static struct k_thread parser_thread;

/*
 * Parser thread: receives three packets and parses them.
 * The first is a normal command, the other two are an attacker's commands,
 * each reading 16 bytes of the key.
 */
static void parser_entry(void *attack_index, void *p2, void *p3)
{
	/* On this thread's stack, so the parser can always access them. */
	char packets[3][32];

	strcpy(packets[0], "get=0");
	snprintf(packets[1], sizeof(packets[1]), "get=%ld", (long)attack_index);
	snprintf(packets[2], sizeof(packets[2]), "get=%ld", (long)attack_index + 1);

	for (int i = 0; i < ARRAY_SIZE(packets); i++) {
		printk("parser: received '%s'\n", packets[i]);
		parse_command(packets[i]);
	}
}

/* Starts the parser thread. */
int main(void)
{
	/* The attacker would compute this index from the firmware's ELF file. */
	long attack_index = ((const char *)credentials_key_addr() -
			     (const char *)parser_settings_addr()) / SETTING_SIZE;

	/* The parser handles untrusted input, so it runs as a user thread without access to kernel memory. */
	k_thread_create(&parser_thread, parser_stack, PARSER_STACK_SIZE,
			parser_entry, (void *)attack_index, NULL, NULL,
			5, K_USER, K_NO_WAIT);
	return 0;
}
```

## src/main.cpp
```c
#include <zephyr/kernel.h>
#include <zephyr/logging/log.h>
#include <zephyr/task_wdt/task_wdt.h>

LOG_MODULE_REGISTER(pipeline, LOG_LEVEL_INF);

#define STACK_SIZE     1024
#define SENSOR_MS      100
#define HEALTH_MS      200
#define QUEUE_SIZE     8
#define WDT_TIMEOUT_MS 1000
#define STUCK_AT_SEQ   10
#define STUCK_MS       5000

struct sensor_data {
	int32_t temperature;
	uint32_t seq;
};

K_MSGQ_DEFINE(sensor_queue, sizeof(struct sensor_data), QUEUE_SIZE, 4);

static void wdt_cb(int channel_id, void *user_data)
{
	LOG_ERR("[WDT] channel %d expired, consumer is stuck", channel_id);
}

static void producer_fn(void *p1, void *p2, void *p3)
{
	struct sensor_data data = {0, 0};

	while (1) {
		k_msleep(SENSOR_MS);
		data.seq++;
		data.temperature = 20 + data.seq % 10;

		if (k_msgq_put(&sensor_queue, &data, K_NO_WAIT) != 0) {
			LOG_WRN("[PRODUCER] queue full, dropped seq=%u", data.seq);
		}
	}
}

static void consumer_fn(void *p1, void *p2, void *p3)
{
	struct sensor_data data;
	int wdt_id = task_wdt_add(WDT_TIMEOUT_MS, wdt_cb, NULL);

	while (1) {
		k_msgq_get(&sensor_queue, &data, K_FOREVER);
		task_wdt_feed(wdt_id);
		LOG_INF("[CONSUMER] seq=%u temp=%d", data.seq, data.temperature);

		if (data.seq == STUCK_AT_SEQ) {
			LOG_WRN("[CONSUMER] stuck for %d ms", STUCK_MS);
			k_msleep(STUCK_MS);
		}
	}
}

static void health_fn(void *p1, void *p2, void *p3)
{
	while (1) {
		k_msleep(HEALTH_MS);
		uint32_t used = k_msgq_num_used_get(&sensor_queue);

		if (used * 4 >= QUEUE_SIZE * 3) {
			LOG_WRN("[HEALTH] queue at %u/%u", used, QUEUE_SIZE);
		}
	}
}

K_THREAD_DEFINE(producer_thread, STACK_SIZE, producer_fn, NULL, NULL, NULL, 5, 0, 0);
K_THREAD_DEFINE(consumer_thread, STACK_SIZE, consumer_fn, NULL, NULL, NULL, 6, 0, 0);
K_THREAD_DEFINE(health_thread, STACK_SIZE, health_fn, NULL, NULL, NULL, 7, 0, 0);

int main(void)
{
	task_wdt_init(NULL);
	return 0;
}
```
